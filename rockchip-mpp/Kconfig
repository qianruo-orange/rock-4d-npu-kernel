## rockchip-mpp/Kconfig
```kconfig
# SPDX-License-Identifier: GPL-2.0-only
config ROCKCHIP_MPP
	tristate "Rockchip MPP VDPU383 decoder and VEPU510 encoder (RK3576)"
	depends on ARCH_ROCKCHIP
	help
	  Rockchip media process platform driver for the VDPU383 decoder
	  and VEPU510 encoder on RK3576. Ported from the vendor MPP tree
	  for Linux 7.4. H.264 decoding is validated on ROCK 4D.
```
